## arch/riscv/cpu/k230/Kconfig
```kconfig
# SPDX-License-Identifier: GPL-2.0+
#
# Copyright (c) 2024, Junhui Liu <liujh2818@outlook.com>

config CANAAN_K230
	bool
	select ARCH_EARLY_INIT_R
	select BINMAN
	imply CPU
	imply CPU_RISCV
	imply RISCV_TIMER
	imply CMD_CPU
	imply SYSRESET
	imply SYSRESET_SYSCON
```
